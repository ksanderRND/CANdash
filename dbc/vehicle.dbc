VERSION ""

NS_ :

BS_:

BU_:

BO_ 100 VehicleSpeed: 8 Vector__XXX
 SG_ Speed : 0|16@1+ (0.1,0) [0|200] "km/h" Vector__XXX

BO_ 200 EngineData: 8 Vector__XXX
 SG_ RPM : 0|16@1+ (0.25,0) [0|8000] "rpm" Vector__XXX
 SG_ CoolantTemp : 16|8@1+ (1,-40) [-40|150] "degC" Vector__XXX

BO_ 300 BatteryData: 8 Vector__XXX
 SG_ SOC : 0|8@1+ (0.4,0) [0|100] "%" Vector__XXX
